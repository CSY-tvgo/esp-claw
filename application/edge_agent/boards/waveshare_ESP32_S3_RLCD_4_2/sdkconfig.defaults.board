## application/edge_agent/boards/waveshare_ESP32_S3_RLCD_4_2/sdkconfig.defaults.board
```kconfig
CONFIG_ESP_DEFAULT_CPU_FREQ_MHZ_240=y

# Waveshare ESP32-S3-RLCD-4.2: 16 MB QIO flash
CONFIG_ESPTOOLPY_FLASHMODE_QIO=y
CONFIG_ESPTOOLPY_FLASHFREQ_80M=y
CONFIG_ESPTOOLPY_FLASHSIZE_16MB=y

# Waveshare ESP32-S3-RLCD-4.2: 8 MB octal PSRAM @ 80 MHz
CONFIG_SPIRAM=y
CONFIG_SPIRAM_MODE_OCT=y
CONFIG_SPIRAM_SPEED_80M=y
```
